#include <FrequencyTimer2.h>
#include<TimerOne.h>
#include<MsTimer2.h>

#define M {\
{0,1,1,0,0,1,1,0},\
{1,0,0,1,1,0,0,1},\
{1,0,0,1,1,0,0,1},\
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{1,0,0,1,1,0,0,1},\
}
#define E {\
{0,1,1,1,1,1,1,1},\
{0,1,1,1,1,1,1,1},\
{0,0,0,0,0,0,0,1},\
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{0,1,1,1,1,1,1,1},\
}
#define C {\
{0,0,1,1,1,1,0,0},\
{0,1,0,0,0,1,1,0},\
{0,0,0,0,0,0,1,1},\
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{0,0,1,1,1,1,0,0},\
}
#define H {\
{0,1,0,0,0,0,1,0},\
{0,1,0,0,0,0,1,0},\
{0,1,0,0,0,0,1,0},\
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{0,1,0,0,0,0,1,0},\
}
#define A{\
{0,0,0,1,1,0,0,0},\
{0,0,1,1,1,1,0,0},\
{0,1,1,0,0,1,1,0},\
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{0,1,0,0,0,0,1,0},\
}
#define T{\
{1,1,1,1,1,1,1,1},\
{1,1,1,1,1,1,1,1},\
{0,0,0,1,1,0,0,0},\
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{0,0,0,1,1,0,0,0},\
}
#define R{\
{0,0,0,1,1,1,1,0},\
{0,0,1,0,0,0,1,0},\
{0,0,1,0,0,0,1,0},\
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{0,0,1,0,0,0,1,0},\
}
#define O{\
{0,0,1,1,1,1,0,0},\
{0,1,0,0,0,0,1,0},\
{1,0,0,0,0,0,0,1},\
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{0,0,1,1,1,1,0,0},\
}
#define N {\
{0,1,0,0,0,0,1,0},\
{0,1,0,0,0,1,1,0},\
{0,1,0,0,1,0,1,0},\
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{0,1,0,0,0,0,1,0},\
}
#define I {\
{0,0,1,1,1,1,0,0},\
{0,0,0,1,1,0,0,0},\
{0,0,0,1,1,0,0,0},\
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{0,0,1,1,1,1,0,0},\
}
#define S{\
{0,0,1,1,1,1,1,0},\
{0,1,0,0,0,0,0,1},\
{0,0,0,0,0,0,0,1},\
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{0,0,0,0,0,0,0,0},\
}

int pin[17] = {-1,22,23,24,25,26,27,28,29,30,31,32,33,34,35,36,37};
int col[8]={pin[9],pin[10],pin[11],pin[12],pin[13],pin[14],pin[15],pin[16]};
int row[8]={pin[1],pin[2],pin[3],pin[4],pin[5],pin[6],pin[7],pin[8]};
int sw = 2;
byte col1 = 0;
byte LED[8][8];
int pattern = 0;
const byte interruptPin = 2;

const int Patterns_no = 12;
byte patterns[Patterns_no][8][8] ={M,E,C,H,A,T,R,O,N,I,C,S};

void setup() {
  pinMode(sw,INPUT);
  attachInterrupt(digitalPinToInterrupt(interruptPin),cnt,FALLING);
  
for(int i=1;i<=16;i++){ //핀모드 설정 
    pinMode(pin[i],OUTPUT);
  }

  for(int i=0;i<8;i++){ //초기화 
    digitalWrite(row[i],LOW);
    digitalWrite(col[i],HIGH);
  }



  FrequencyTimer2::setOnOverflow(display);

  pinMode(sw,INPUT);

  Pattern_output(pattern);
}

void loop() {
 
}



void Pattern_output(int pattern){
  for(int i=0;i<8;i++){
    for(int j=0;j<8;j++){
      LED[i][j] = patterns[pattern][j][i];
    }
  }
}

void display(){
  digitalWrite( col[col1],HIGH);
  col1++;
  
  if(col1==8){
    col1=0;
  }
  
  for(int row1=0;row1<8;row1++){
    if(LED[col1][7-row1] == 1){
      digitalWrite(row[row1],HIGH);
    }
    else{
      digitalWrite(row[row1],LOW);
    }
  }
  digitalWrite(col[col1],LOW);
}

void cnt(){
   int sw_status = digitalRead(sw);

  if(sw_status == LOW){
    if(pattern == 11){
      pattern = 0;
    }
    else{
      pattern++;
      delay(300);
    }
  }
  Pattern_output(pattern);

}
